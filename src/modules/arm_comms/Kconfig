## src/modules/arm_comms/Kconfig
```kconfig
menuconfig MODULES_ARM_COMMS
	bool "arm_comms"
	default n
	---help---
		Enable the copter arm comms module
```

## src/modules/arm_controller/Kconfig
```kconfig
menuconfig MODULES_ARM_CONTROLLER
	bool "arm_controller"
	default n
	---help---
		Enable the copter arm controller
```

## src/modules/arm_state_estimator/Kconfig
```kconfig
menuconfig MODULES_ARM_STATE_ESTIMATOR
	bool "arm_state_estimator"
	default n
	---help---
		Enable enable the copter arm state estimator
```
